RADIX	    DEC
PROCESSOR   18F45K50
#INCLUDE    <p18f45k50.inc>
	
VAR1	EQU	1
VAR2	EQU	2
TEMP	EQU	3
FLAGS	EQU	4
COUNT	EQU	5
	
	ORG	    00H
	
	GOTO	    MAIN
	
    ; HIGH PRIORITY INTERRUPTS
	ORG	    08H
	BTFSC	    INTCON, TMR0IF
	GOTO	    INT0ISR
	BTFSC	    PIR1, TMR1IF
	GOTO	    INT1ISR
	
    ; LOW PRIORITY INTERRUPTS
	ORG	    18H
    
	ORG	    40H
MAIN:	
    MOVLB	    15
    
	BSF	        ANSELA,1
	BCF	        ANSELA,2
	BCF	        ANSELA,3
	SETF	    TRISA
	; SERIAL COMMUNICATION
	CLRF	    ANSELC, BANKED
	BSF	        TRISC, RX
	BCF	        TRISC, TX
	; OUTPUT
	CLRF	    ANSELB, BANKED
	CLRF	    TRISB
	CLRF	    LATB
	
	CLRF	    FLAGS
	CLRF	    TEMP
	
	CALL	    CONFIG_SERIAL
	CALL	    CONFIG_ADC
	CALL	    CONFIG_INTERRUPT
	CALL	    CONFIG_TIMER
	CALL	    CONFIG_SOUND
	

NORMAL:
	CLRF	    COUNT
	BSF	        LATB, 6 ; TURN ON GREEN LED
	BCF	        FLAGS, 0 ; TURN OFF SOUND FLAG
	BCF	        LATB, 7 ; TURN OFF SOUND
	BCF	        FLAGS, 1 ; TURN OFF COUNTER FLAG
	BCF	        LATB, 5 ; TURN OFF RED LED
NORMAL_LOOP:
	BCF	        LATB, 3
	
	MOVLW	    60
	CPFSLT	    TEMP
	BRA	        DANGER
	BRA	        NORMAL_LOOP
	
DANGER:
	BCF	        LATB, 6 ; TURN OFF GREEN LED
	BSF	        LATB, 5 ; TURN ON RED LED
	BSF	        FLAGS, 1 ; TURN ON COUNTER FLAG
	BSF	        FLAGS, 0 ; TURN ON SOUND FLAG
DANGER_LOOP:
	BSF	        LATB, 3
	
	MOVLW	    30
	CPFSGT	    TEMP
	BRA	        NORMAL
	BRA	        DANGER_LOOP
WRITE:
	BTFSS	    PIR1, TXIF
	BRA	        WRITE
	MOVWF	    TXREG1
	RETURN
	
;READ TEMPERATURE SENSOR
READ_TEMP:
	BSF	        ADCON0,GO ;START THE CONVERTION
READ_TEMP_LOOP:
	BTFSC	    ADCON0,GO
	BRA	        READ_TEMP_LOOP
	;RESULT IS COMPLETE
	MOVFF	    ADRESH,TEMP
    
	RETURN
	
CONFIG_SERIAL:
	MOVLW	    0F6H
	MOVWF	    OSCCON ; ADJUSTING CLOCK SPEED TO 16
	MOVLW	    25
	MOVWF	    SPBRG1  ; SET BAUD RATE TO 9600
	MOVLW	    20H
	MOVWF	    TXSTA1
	BSF	        RCSTA1, 7	; SPEN
	BSF	        RCSTA1, 4	; CREN
	RETURN
	
CONFIG_ADC:
	;CHOOSE CHANEL 1, AND ENABLE ADC  
	MOVLW	    B'00000101'
	MOVWF	    ADCON0 
	MOVLW	    B'00000101'
	MOVWF	    ADCON1
	MOVLW	    B'00111101'
	MOVWF	    ADCON2
	RETURN
	
CONFIG_INTERRUPT:
    BSF	        RCON, IPEN ; ENABLE PRIORITY ON INTERRUPTS
	BSF	        INTCON, GIEH ; ENABLE HIGH PRIORITY INTERRUPTS
    BSF	        INTCON, GIEL ; ENABLE LOW PRIORITY INTERRUPTS
	BSF	        INTCON, TMR0IE ; ENABLE TIMER 0 INTERRUPT
	BCF	        INTCON, TMR0IF ; CLEAR TIMER 0 FLAG
	BSF	        INTCON2, TMR0IP ; SET TIMER 0 INTERRUPT AS HIGH PRIORITY
	
	BSF	        IPR1, TMR1IP ; SET TIMER 1 INTERRPUT AS HIGH PRIORITY
	BCF	        PIR1, TMR1IF ; CLEAR TIMER 1 FLAG
	BSF	        PIE1, TMR1IE ; ENABLE TIMER 1 INTERRPUT
	RETURN
	
CONFIG_TIMER:
    ; 1 SECOND TIMER
	MOVLW	    B'00000111'
	MOVWF	    T0CON
	MOVLW	    H'F6'
	MOVWF	    TMR0L
	MOVLW	    0C2H
	MOVWF	    TMR0H
	BSF	        T0CON, 7
	RETURN
	
CONFIG_SOUND:
    ; FREQUENCY OF 1.2kHz
	CLRF	    T1CON
	MOVLW	    H'7D'
	MOVWF	    TMR1L
	MOVLW	    H'F9'
	MOVWF	    TMR1H
	BSF	        T1CON, 0
	RETURN
	
	
	ORG	    200H
	
INT0ISR:
	BCF	        INTCON, TMR0IF
	
	CALL	    READ_TEMP
	MOVF	    TEMP, 0
	CALL	    WRITE
	
	MOVLW	    H'F6'
	MOVWF	    TMR0L
	MOVLW	    0C2H
	MOVWF	    TMR0H
	
	BTFSC	    FLAGS, 1
	INCF	    COUNT, 1
	MOVLW	    5
	CPFSLT	    COUNT
	CALL	    RESET_LED
	RETFIE
	
RESET_LED:
	CLRF	    COUNT
	BCF	        FLAGS, 1
	BCF	        LATB, 5
	RETURN

INT1ISR:
	BCF	        PIR1, TMR1IF
	BTFSC	    FLAGS, 0
	BTG	        LATB, 7
	MOVLW	    H'7D'
	MOVWF	    TMR1L
	MOVLW	    H'F9'
	MOVWF	    TMR1H
	RETFIE

	END
